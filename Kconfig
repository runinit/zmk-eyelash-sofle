## Kconfig
```kconfig
# Copyright (c) 2024 ZMK Contributors
# SPDX-License-Identifier: MIT

config ZMK_RGB_DUAL_BREATH
    bool "Enable Dual-Color Breathing RGB Effect"
    depends on ZMK_RGB_UNDERGLOW
    help
      Enable a custom dual-color breathing effect that alternates
      between two configurable colors while breathing.

if ZMK_RGB_DUAL_BREATH

config ZMK_RGB_DUAL_BREATH_COLOR1_HUE
    int "First color hue (0-359)"
    default 120
    range 0 359
    help
      Hue value for the first breathing color (green=120, blue=240, red=0).

config ZMK_RGB_DUAL_BREATH_COLOR2_HUE
    int "Second color hue (0-359)"
    default 240
    range 0 359
    help
      Hue value for the second breathing color (green=120, blue=240, red=0).

config ZMK_RGB_DUAL_BREATH_SATURATION
    int "Breathing colors saturation (0-100)"
    default 100
    range 0 100
    help
      Saturation value for both breathing colors.

endif # ZMK_RGB_DUAL_BREATH
```

## boards/eyelash_sofle/Kconfig
```kconfig
config BOARD_EYELASH_SOFLE_LEFT
    select BOARD_EYELASH_SOFLE

config BOARD_EYELASH_SOFLE_RIGHT
    select BOARD_EYELASH_SOFLE

config BOARD_EYELASH_SOFLE
    bool
    select SOC_NRF52840_QIAA

config BOARD_EYELASH_SOFLE_LEFT
    bool
    default y if BOARD_EYELASH_SOFLE_NRF52840_LEFT
    select BOARD_EYELASH_SOFLE

config BOARD_EYELASH_SOFLE_RIGHT
    bool
    default y if BOARD_EYELASH_SOFLE_NRF52840_RIGHT
    select BOARD_EYELASH_SOFLE

rsource "Kconfig.defconfig"
```

## boards/eyelash_sofle/board.yml
```yaml
board:
  name: eyelash_sofle
  vendor: custom
  socs:
    - name: nrf52840
      variants:
        - name: left
        - name: right
```

## config/west.yml
```yaml
manifest:
  remotes:
    - name: zmkfirmware
      url-base: https://github.com/zmkfirmware
      # Additional modules containing boards/shields/custom code can be listed here as well.
      # See:
      # - https://zmk.dev/docs/features/modules
      # - https://docs.zephyrproject.org/3.5.0/develop/west/manifest.html#projects
    - name: darknao
      url-base: https://github.com/darknao
    - name: gpeye
      url-base: https://github.com/GPeye
  projects:
    - name: mario-peripheral-animation
      remote: gpeye
      revision: main 
    - name: zmk
      remote: darknao
      revision: rgb-layer-25.08
      import: app/west.yml
  self:
    path: boards
```
